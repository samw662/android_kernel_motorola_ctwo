/dts-v1/;
/plugin/;

#include "cliffs-kiwi-bt-ctwo.dtsi"

/ {
	model = "ctwo";
	compatible = "qcom,cliffs";
	qcom,msm-id = <614 0x10000>, <632 0x10000>;
	qcom,board-id = <0x41 0x9300>, <0x41 0xB100>, <0x41 0xB1B0>;
};
