/dts-v1/;
/plugin/;

#include "pineapple-kiwi-bt-arcf.dtsi"

/ {
	model = "arcf";
	compatible = "qcom,pineapple", "qcom,pineapplep";
	qcom,msm-id = <557 0x10000>, <577 0x10000>, <557 0x20000>, <577 0x20000>;
	//qcom,board-id = <0 0>;
	qcom,board-id = <0x43 0xA1A0>, <0x43 0xA200>;
};
