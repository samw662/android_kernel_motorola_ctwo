/* this is derivated from qcom pineapple-ese-mtp.dts*/

/dts-v1/;
/plugin/;

#include "pineapple-ese-ctwo-common.dtsi"

/ {
	model = "ctwo";
	compatible = "qcom,pineapple-mtp", "qcom,pineapple", "qcom,mtp";
	qcom,msm-id = <557 0x10000>;
	qcom,board-id = <0x41 0x9300>;
};
