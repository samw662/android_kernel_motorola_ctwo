/dts-v1/;
/plugin/;

#include "cliffs-kiwi-cnss-pmu-s3b.dtsi"

/ {
	model = "arcfox";
	compatible = "qcom,cliffs";
	qcom,msm-id = <614 0x10000>, <632 0x10000>;
	qcom,board-id = <0x43 0xA300>, <0x43 0xB1B0>;
};
